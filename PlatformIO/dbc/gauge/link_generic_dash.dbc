VERSION "c2g-draft-1"

NS_ :

BS_:

BU_: LINK_ECU

BO_ 1000 LINK_GenericDash: 8 LINK_ECU
 SG_ FrameIndex M : 0|8@1+ (1,0) [0|255] "" Vector__XXX
 SG_ FrameByte1 : 8|8@1+ (1,0) [0|255] "" Vector__XXX
 SG_ EngineSpeed m0 : 16|16@1+ (1,0) [0|65535] "rpm" Vector__XXX
 SG_ MAP m0 : 32|16@1+ (1,0) [0|65535] "kPa" Vector__XXX
 SG_ MGP m0 : 48|16@1+ (1,-100) [-100|65435] "kPa" Vector__XXX
 SG_ BaroPressure m1 : 16|16@1+ (0.1,0) [0|6553.5] "kPa" Vector__XXX
 SG_ TPS m1 : 32|16@1+ (0.1,0) [0|6553.5] "%" Vector__XXX
 SG_ InjectorDC m1 : 48|16@1+ (0.1,0) [0|6553.5] "%" Vector__XXX
 SG_ InjectorDCSecondary m2 : 16|16@1+ (0.1,0) [0|6553.5] "%" Vector__XXX
 SG_ InjectorPWActual m2 : 32|16@1+ (0.001,0) [0|65.535] "ms" Vector__XXX
 SG_ ECT m2 : 48|16@1+ (1,-50) [-50|65485] "C" Vector__XXX
 SG_ IAT m3 : 16|16@1+ (1,-50) [-50|65485] "C" Vector__XXX
 SG_ ECUVolts m3 : 32|16@1+ (0.01,0) [0|655.35] "V" Vector__XXX
 SG_ MAF m3 : 48|16@1+ (0.1,0) [0|6553.5] "g/s" Vector__XXX
 SG_ GearPosition m4 : 16|16@1+ (1,0) [0|65535] "" Vector__XXX
 SG_ InjectorTiming m4 : 32|16@1+ (1,0) [0|65535] "deg" Vector__XXX
 SG_ IgnitionTiming m4 : 48|16@1+ (0.1,-100) [-100|6453.5] "deg" Vector__XXX
 SG_ CamInletPositionL m5 : 16|16@1+ (0.1,0) [0|6553.5] "deg" Vector__XXX
 SG_ CamInletPositionR m5 : 32|16@1+ (0.1,0) [0|6553.5] "deg" Vector__XXX
 SG_ CamExhaustPositionL m5 : 48|16@1+ (-0.1,0) [-6553.5|0] "deg" Vector__XXX
 SG_ CamExhaustPositionR m6 : 16|16@1+ (-0.1,0) [-6553.5|0] "deg" Vector__XXX
 SG_ Lambda1 m6 : 32|16@1+ (0.001,0) [0|65.535] "lambda" Vector__XXX
 SG_ Lambda2 m6 : 48|16@1+ (0.001,0) [0|65.535] "lambda" Vector__XXX
 SG_ Trig1ErrorCounter m7 : 16|16@1+ (1,0) [0|65535] "" Vector__XXX
 SG_ FaultCodes m7 : 32|16@1+ (1,0) [0|65535] "" Vector__XXX
 SG_ FuelPressure m7 : 48|16@1+ (1,0) [0|65535] "kPa" Vector__XXX
 SG_ OilTemp m8 : 16|16@1+ (1,-50) [-50|65485] "C" Vector__XXX
 SG_ OilPressure m8 : 32|16@1+ (1,0) [0|65535] "kPa" Vector__XXX
 SG_ WheelSpeedLF m8 : 48|16@1+ (0.1,0) [0|6553.5] "km/h" Vector__XXX
 SG_ WheelSpeedLR m9 : 16|16@1+ (0.1,0) [0|6553.5] "km/h" Vector__XXX
 SG_ WheelSpeedRF m9 : 32|16@1+ (0.1,0) [0|6553.5] "km/h" Vector__XXX
 SG_ WheelSpeedRR m9 : 48|16@1+ (0.1,0) [0|6553.5] "km/h" Vector__XXX
 SG_ KnockLevel1 m10 : 16|16@1+ (5,0) [0|327675] "" Vector__XXX
 SG_ KnockLevel2 m10 : 32|16@1+ (5,0) [0|327675] "" Vector__XXX
 SG_ KnockLevel3 m10 : 48|16@1+ (5,0) [0|327675] "" Vector__XXX
 SG_ KnockLevel4 m11 : 16|16@1+ (5,0) [0|327675] "" Vector__XXX
 SG_ KnockLevel5 m11 : 32|16@1+ (5,0) [0|327675] "" Vector__XXX
 SG_ KnockLevel6 m11 : 48|16@1+ (5,0) [0|327675] "" Vector__XXX
 SG_ KnockLevel7 m12 : 16|16@1+ (5,0) [0|327675] "" Vector__XXX
 SG_ KnockLevel8 m12 : 32|16@1+ (5,0) [0|327675] "" Vector__XXX
 SG_ Limit_RPMLimit m12 : 48|1@1+ (1,0) [0|1] "" Vector__XXX
 SG_ Limit_MAPLimit m12 : 49|1@1+ (1,0) [0|1] "" Vector__XXX
 SG_ Limit_SpeedLimit m12 : 50|1@1+ (1,0) [0|1] "" Vector__XXX
 SG_ Limit_MaxIgnitionFlag m12 : 51|1@1+ (1,0) [0|1] "" Vector__XXX
 SG_ Limit_AntilagIgnCut m12 : 52|1@1+ (1,0) [0|1] "" Vector__XXX
 SG_ Limit_HighSupplyVoltLimit m12 : 53|1@1+ (1,0) [0|1] "" Vector__XXX
 SG_ Limit_OverrunFlag m12 : 54|1@1+ (1,0) [0|1] "" Vector__XXX
 SG_ Limit_TractionLimit m12 : 55|1@1+ (1,0) [0|1] "" Vector__XXX
 SG_ Limit_LowSupplyVoltFlag m12 : 56|1@1+ (1,0) [0|1] "" Vector__XXX
 SG_ Limit_LaunchRPMLimit m12 : 57|1@1+ (1,0) [0|1] "" Vector__XXX
 SG_ Limit_WakeupFlag m12 : 58|1@1+ (1,0) [0|1] "" Vector__XXX
 SG_ Limit_GPRPMLimit1 m12 : 59|1@1+ (1,0) [0|1] "" Vector__XXX
 SG_ Limit_CLStepperLimit m12 : 60|1@1+ (1,0) [0|1] "" Vector__XXX
 SG_ Limit_GPRPMLimit2 m12 : 61|1@1+ (1,0) [0|1] "" Vector__XXX
 SG_ Limit_EThrottleLimit m12 : 62|1@1+ (1,0) [0|1] "" Vector__XXX
 SG_ Limit_CyclicIdleActive m12 : 63|1@1+ (1,0) [0|1] "" Vector__XXX

CM_ "DRAFT can2gauge DBC: Link G4+/G4X/G5 'Transmit Generic Dash' compound stream. ID, bit rate and rate are set by the tuner (1000 / 1 Mbit / 20 Hz are only the common template values).";
CM_ BO_ 1000 "Source: Link G4+ PCLink help, Generic Dash. G4X/G5 assumed identical (AiM's Generic Dash.lcc channel list matches) - UNVERIFIED on G4X/G5. ID 1000 is the usual template value; the real ID is whatever the tuner set (GaugeRelocatable). Transmit rate user set, 20 Hz typical; whether that is per frame or per full 13-frame cycle is not stated - UNVERIFIED.";
CM_ SG_ 1000 FrameIndex "Compound frame index 0..12 (Link calls them Frame 1..13).";
CM_ SG_ 1000 FrameByte1 "Always 0 per the table. Fingerprint: byte 0 cycles 0..12 and byte 1 stays 0.";
CM_ SG_ 1000 MAP "Absolute kPa (gauge 'map' is mbar: x10).";
CM_ SG_ 1000 MGP "Gauge pressure = raw - 100 kPa.";
CM_ SG_ 1000 GearPosition "Range 0-6. Reverse encoding not documented - UNVERIFIED.";
CM_ SG_ 1000 CamExhaustPositionL "Display = raw x -0.1.";
CM_ SG_ 1000 FuelPressure "kPa (gauge is bar: /100). Gauge or absolute not stated - UNVERIFIED.";
CM_ SG_ 1000 OilPressure "kPa (gauge is bar: /100). Gauge or absolute not stated - UNVERIFIED.";
CM_ SG_ 1000 Limit_RPMLimit "Limits Flags word (bytes 6-7, low byte first); bit 0 taken as the word's least significant bit - UNVERIFIED.";
BA_DEF_ SG_ "GaugeKey" STRING ;
BA_DEF_ "GaugeRelocatable" INT 0 1;
BA_DEF_ "GaugeBusSpeed" INT 0 1000000;
BA_DEF_ BO_ "GenMsgCycleTime" INT 0 65535;
BA_DEF_DEF_ "GaugeKey" "";
BA_DEF_DEF_ "GaugeRelocatable" 0;
BA_DEF_DEF_ "GaugeBusSpeed" 500000;
BA_DEF_DEF_ "GenMsgCycleTime" 0;
BA_ "GaugeBusSpeed" 1000000;
BA_ "GaugeRelocatable" 1;
BA_ "GenMsgCycleTime" BO_ 1000 50;
BA_ "GaugeKey" SG_ 1000 EngineSpeed "rpm";
BA_ "GaugeKey" SG_ 1000 MAP "map";
BA_ "GaugeKey" SG_ 1000 TPS "throttle";
BA_ "GaugeKey" SG_ 1000 InjectorDC "injDuty";
BA_ "GaugeKey" SG_ 1000 ECT "coolant";
BA_ "GaugeKey" SG_ 1000 IAT "iat";
BA_ "GaugeKey" SG_ 1000 ECUVolts "batt";
BA_ "GaugeKey" SG_ 1000 MAF "maf";
BA_ "GaugeKey" SG_ 1000 GearPosition "gear";
BA_ "GaugeKey" SG_ 1000 IgnitionTiming "timing";
BA_ "GaugeKey" SG_ 1000 Lambda1 "lambda";
BA_ "GaugeKey" SG_ 1000 FuelPressure "fuelPressure";
BA_ "GaugeKey" SG_ 1000 OilTemp "oiltemp";
BA_ "GaugeKey" SG_ 1000 OilPressure "oilPressure";
VAL_ 1000 GearPosition 0 "N" ;
